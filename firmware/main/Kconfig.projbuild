## firmware/main/Kconfig.projbuild
```kconfig
menu "MagniBot bancada"
config MAGNIBOT_ESTOP_GPIO
    int "GPIO de emergencia validado (-1 = nao conectado)"
    range -1 48
    default 6
    help
        Botao de emergencia ativo baixo com pull-up e interrupcao por borda de
        descida. O padrao e o GPIO6 do esquematico (BTN_EMERG_GPIO em config.h);
        sem o botao ligado o pino fica em nivel alto e nada dispara. Confirme a
        ligacao antes de confiar nele. Esta entrada nao substitui o corte fisico
        de potencia.

config MAGNIBOT_BENCH_SERVO
    bool "Habilitar comandos de servo de bancada (<GPIO> <GRAUS>)"
    default n
    help
        Permite mover servos de 180 graus soltos na bancada pelo terminal serial,
        com o comando "<GPIO> <GRAUS>". So habilite com o servo fixado, alimentacao
        externa com terra comum e meio de cortar a alimentacao. O servo da base
        (giro continuo) e recusado. A emergencia para os pulsos de PWM mas nao e
        um corte fisico de potencia.

config MAGNIBOT_SERVO_MAX_DPS
    int "Velocidade maxima de variacao (graus por segundo)"
    depends on MAGNIBOT_BENCH_SERVO
    range 1 360
    default 90
    help
        Limita a rampa entre comandos consecutivos no mesmo GPIO. O primeiro
        comando de cada GPIO vai direto ao alvo, na velocidade do proprio servo.
config MAGNIBOT_BASE_SCAN
    bool "Habilitar varredura temporizada da base no GPIO 15"
    depends on MAGNIBOT_BENCH_SERVO
    default n
config MAGNIBOT_TOF
    bool "Habilitar leitura VL53L0X nos GPIOs 11 e 12"
    default n
    help
        Habilita apenas aquisicao de distancia. Nao autoriza atuadores.
config MAGNIBOT_TOF_DIAGNOSTIC
    bool "Repetir diagnostico VL53L0X sem PWM"
    depends on MAGNIBOT_TOF && !MAGNIBOT_BENCH_SERVO
    default n
config MAGNIBOT_UART_COMMANDS
    bool "Receber comandos pela UART do console"
    depends on ESP_CONSOLE_UART
    default n
    help
        Selecione somente para receber pelo conversor USB-UART ligado ao console
        (GPIOs 43/44 no ESP32-S3). Para o conector USB nativo/JTAG, mantenha
        desabilitado e habilite o console USB Serial/JTAG primario ou secundario.
config MAGNIBOT_SHOULDER_MIN_US
    int "Ombro: menor pulso permitido na bancada (us)"
    depends on MAGNIBOT_BENCH_SERVO
    range 500 1915
    default 500
    help
        Limite inferior de calibracao. Use o valor conferido na montagem atual.

config MAGNIBOT_SHOULDER_MAX_US
    int "Ombro: maior pulso permitido na bancada (us)"
    depends on MAGNIBOT_BENCH_SERVO
    range 1917 2500
    default 2500
    help
        Limite superior de calibracao. Use o valor conferido na montagem atual.
endmenu
```

## firmware/sdkconfig.defaults.bench
```kconfig
CONFIG_MAGNIBOT_ESTOP_GPIO=6
CONFIG_MAGNIBOT_BENCH_SERVO=y
CONFIG_MAGNIBOT_SERVO_MAX_DPS=90
CONFIG_MAGNIBOT_BASE_SCAN=y
CONFIG_MAGNIBOT_TOF=y
# CONFIG_MAGNIBOT_TOF_DIAGNOSTIC is not set
CONFIG_MAGNIBOT_UART_COMMANDS=y
CONFIG_MAGNIBOT_SHOULDER_MIN_US=500
CONFIG_MAGNIBOT_SHOULDER_MAX_US=2500
```
